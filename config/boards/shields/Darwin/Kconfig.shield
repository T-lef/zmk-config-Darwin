## config/boards/shields/Darwin/Kconfig.shield
```kconfig
# Copyright (c) 2020 Pete Johanson
# SPDX-License-Identifier: MIT

config SHIELD_Darwin_LEFT
    def_bool $(shields_list_contains,Darwin_left)

config SHIELD_Darwin_RIGHT
    def_bool $(shields_list_contains,Darwin_right)
```
